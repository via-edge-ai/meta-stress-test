## conf/layer.conf
```bitbake
# We have a conf and classes directory, add to BBPATH
BBPATH .= ":${LAYERDIR}"

# We have recipes-* directories, add to BBFILES
BBFILES += "${LAYERDIR}/recipes-*/*/*.bb \
            ${LAYERDIR}/recipes-*/*/*.bbappend"

BBFILE_COLLECTIONS += "stress-test"
BBFILE_PATTERN_stress-test = "^${LAYERDIR}/"
BBFILE_PRIORITY_stress-test = "9"

LAYERDEPENDS_stress-test = "core rity nn"

LAYERSERIES_COMPAT_stress-test = "dunfell kirkstone"
```
